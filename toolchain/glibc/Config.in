## toolchain/glibc/Config.in
```kconfig
choice
	prompt "glibc version"
	depends on TOOLCHAINOPTS && USE_GLIBC && !EXTERNAL_TOOLCHAIN
	default GLIBC_USE_VERSION_2_27
	help
	  Select the version of glibc you wish to use.

	config GLIBC_USE_VERSION_2_24
		bool "glibc 2.24"
		select GLIBC_VERSION_2_24
		
	config GLIBC_USE_VERSION_2_27
		bool "glibc 2.27"
		select GLIBC_VERSION_2_27

endchoice
```
